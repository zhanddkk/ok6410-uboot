## u-boot-2017.03/arch/arm/mach-s3c6410/Kconfig
```kconfig
if ARCH_S3C6410

choice
	prompt "S3C6410 board select"
	optional

config TARGET_OK6410
	bool "OK6410 board"
	select OF_CONTROL

endchoice

config SYS_SOC
	default "s3c6410"

source "board/forlinx/ok6410/Kconfig"

endif
```

## u-boot-2017.03/board/forlinx/ok6410/Kconfig
```kconfig
if TARGET_OK6410

config SYS_BOARD
	default "ok6410"

config SYS_VENDOR
	default "forlinx"

config SYS_CONFIG_NAME
	default "ok6410"

endif
```
